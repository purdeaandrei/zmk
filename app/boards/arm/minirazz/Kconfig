## app/boards/arm/minirazz/Kconfig
```kconfig
# MiniRazz controller for the Unicomp Mini M configuration

# Copyright (c) 2021-2023 Andrei Purdea
# SPDX-License-Identifier: Apache-2.0

config DISABLE_NUMLOCK_TOGGLES_LAYER
	bool "Disable toggling a layer on NumLock locklight status change"
	depends on BOARD_MINIRAZZ
	default n

config NUMLOCK_TOGGLES_THIS_LAYER
	int "The number of the layer that NumLock toggles"
	depends on !DISABLE_NUMLOCK_TOGGLES_LAYER
	default 1
```

## app/boards/arm/minirazz/Kconfig.board
```kconfig
# MiniRazz controller for the Unicomp Mini M configuration

# Copyright (c) 2021-2023 Pete Johanson, Andrei Purdea
# SPDX-License-Identifier: Apache-2.0

config BOARD_MINIRAZZ
	bool "MiniRazz controller for the Unicomp Mini M"
	depends on SOC_RP2040
```

## app/boards/arm/minirazz/Kconfig.defconfig
```kconfig
# MiniRazz controller for the Unicomp Mini M keyboard configuration

# Copyright (c) 2021-2023 Pete Johanson, Andrei Purdea
# SPDX-License-Identifier: Apache-2.0

if BOARD_MINIRAZZ

config ZMK_KEYBOARD_NAME
	default "MiniRazz"

config RP2_FLASH_W25Q080
	default y

config BOARD
	default "minirazz"

config ZMK_KSCAN_MATRIX_POLLING
	default y
	# Needed because the parallel-input shift register makes it not possible to use interrupts

endif # BOARD_MINIRAZZ
```

## app/boards/arm/minirazz/minirazz_defconfig
```kconfig
# SPDX-License-Identifier: Apache-2.0

CONFIG_SOC_SERIES_RP2XXX=y
CONFIG_SOC_RP2040=y
CONFIG_BOARD_MINIRAZZ=y

CONFIG_SYS_CLOCK_HW_CYCLES_PER_SEC=125000000

# Enable GPIO
CONFIG_GPIO=y

# enable uart driver
CONFIG_SERIAL=n

# enable console
CONFIG_CONSOLE=n
CONFIG_UART_CONSOLE=n
CONFIG_UART_INTERRUPT_DRIVEN=n
CONFIG_ZMK_USB=y
CONFIG_USB_SELF_POWERED=n
CONFIG_USB_DEVICE_REMOTE_WAKEUP=y

# Note: MAX_POWER is in units of 2mA
# TODO: change this to 250 if adding solenoid driver support:
CONFIG_USB_MAX_POWER=50

# Code partition needed to target the correct flash range
CONFIG_USE_DT_CODE_PARTITION=y

# Output UF2 by default, native bootloader supports it.
CONFIG_BUILD_OUTPUT_UF2=y

CONFIG_SPI=y

CONFIG_ZMK_KSCAN_MATRIX_WAIT_BEFORE_INPUTS=1
CONFIG_ZMK_KSCAN_MATRIX_WAIT_BETWEEN_OUTPUTS=0

CONFIG_USB_HID_POLL_INTERVAL_MS=1

CONFIG_ZMK_LED_INDICATORS=y
CONFIG_LED_GPIO=y
CONFIG_RESET=y


CONFIG_USB_HID_BOOT_PROTOCOL=y
CONFIG_USB_HID_PROTOCOL_CODE=1
```

## app/west.yml
```yaml
manifest:
  remotes:
    - name: zephyrproject-rtos
      url-base: https://github.com/zephyrproject-rtos
    - name: zmkfirmware
      url-base: https://github.com/zmkfirmware
    - name: purdeaandrei
      url-base: https://github.com/purdeaandrei
  projects:
    - name: zephyr
      remote: purdeaandrei
      revision: zephyr_changes_needed_for_minirazz_may_change_history
      import:
        # TODO: Rename once upstream offers option like `exclude` or `denylist`
        name-blacklist:
          - ci-tools
          - hal_altera
          - hal_cypress
          - hal_infineon
          - hal_microchip
          - hal_nxp
          - hal_openisa
          - hal_silabs
          - hal_xtensa
          - hal_st
          - hal_ti
          - loramac-node
          - mcuboot
          - mcumgr
          - net-tools
          - openthread
          - edtt
          - trusted-firmware-m
          - sof
  self:
    west-commands: scripts/west-commands.yml
```
